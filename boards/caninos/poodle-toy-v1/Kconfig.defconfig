## boards/caninos/poodle-toy-v1/Kconfig.defconfig
```kconfig
# SPDX-License-Identifier: Apache-2.0

if BOARD_POODLE_TOY_V1

config BOOTLOADER_MCUBOOT
	default y

config MCUBOOT_GENERATE_UNSIGNED_IMAGE
	default y

choice MCUBOOT_BOOTLOADER_MODE
	default MCUBOOT_BOOTLOADER_MODE_RAM_LOAD
endchoice

endif
```

## boards/caninos/poodle-toy-v2/Kconfig.sysbuild
```kconfig
# SPDX-License-Identifier: Apache-2.0

choice BOOTLOADER
	default BOOTLOADER_MCUBOOT
endchoice

choice MCUBOOT_MODE
	default MCUBOOT_MODE_SINGLE_APP_RAM_LOAD
endchoice

choice BOOT_SIGNATURE_TYPE
	default BOOT_SIGNATURE_TYPE_NONE
endchoice
```

## boards/caninos/puppy-testboard/Kconfig.defconfig
```kconfig
# SPDX-License-Identifier: Apache-2.0

if BOARD_PUPPY_TESTBOARD

config BOOTLOADER_MCUBOOT
	default y

config MCUBOOT_GENERATE_UNSIGNED_IMAGE
	default y

choice MCUBOOT_BOOTLOADER_MODE
	default MCUBOOT_BOOTLOADER_MODE_RAM_LOAD
endchoice

endif
```

## dts/bindings/misc/caninos,puppy-udma-filter.yaml
```yaml
# Copyright (c) Ana Clara Forcelli <ana.forcelli@lsitec.org.br>
# SPDX-License-Identifier: Apache-2.0

description: PUPPY's UDMA Filter DSP Accelerator

compatible: "caninos,puppy-udma-filter"

include: base.yaml

properties:
  reg:
    required: true
```
