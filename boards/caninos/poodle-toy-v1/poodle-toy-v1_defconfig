## boards/caninos/poodle-toy-v1/poodle-toy-v1_defconfig
```kconfig
CONFIG_SERIAL=y
CONFIG_CONSOLE=y
CONFIG_UART_CONSOLE=y

# MCUBoot Image Options
CONFIG_BOOTLOADER_MCUBOOT=y
CONFIG_MCUBOOT_BOOTLOADER_MODE_SINGLE_APP_RAM_LOAD=y
CONFIG_MCUBOOT_GENERATE_UNSIGNED_IMAGE=y
```

## drivers/clock_control/Kconfig.puppy
```kconfig
# Copyright (c) 2026 Edgar Bernardi Righi
#
# SPDX-License-Identifier: Apache-2.0

config CLOCK_CONTROL_PUPPY
	bool "Puppy UDMA clock control"
	default y
	depends on DT_HAS_CANINOS_PUPPY_UDMA_CLOCK_ENABLED
```

## drivers/counter/Kconfig.puppy
```kconfig
# Copyright (c) 2026 Caninos Loucos <ana.forcelli@lsitec.org.br>
# Copyright (c) 2026 Edgar Bernardi Righi <edgar.righi@lsitec.org.br>
# SPDX-License-Identifier: Apache-2.0

config COUNTER_PUPPY
	bool "Puppy Counter Driver"
	default y
	depends on DT_HAS_CANINOS_PUPPY_COUNTER_ENABLED
	help
	  Enable the Caninos Counter driver.
	  Says n if not sure.
```

## drivers/interrupt_controller/Kconfig.puppy
```kconfig
# Copyright (c) 2026 Edgar Bernardi Righi <edgar.righi@lsitec.org.br>
# SPDX-License-Identifier: Apache-2.0

config PUPPY_EVENT_INTC
	bool "Puppy Event Interrupt Controller"
	default y
	select MULTI_LEVEL_INTERRUPTS
	select 2ND_LEVEL_INTERRUPTS
	depends on DT_HAS_CANINOS_PUPPY_EVTC_ENABLED
	help
	  Puppy Event Interrupt Controller provides support for device events.
```

## drivers/misc/hwaccel/Kconfig.pulp
```kconfig
# Copyright (c) 2026 Ana Clara Forcelli <ana.forcelli@lsitec.org.br>
# SPDX-License-Identifier: Apache-2.0

config PULP_UDMA_FILTER
    bool "Enable PULP's in-chip DSP accelerator"
	depends on DT_HAS_PULP_UDMA_FILTER_ENABLED
    default y
```

## dts/bindings/clock/caninos,puppy-udma-clock.yaml
```yaml
# Copyright (c) 2026 Edgar Bernardi Righi
# SPDX-License-Identifier: Apache-2.0

description: Caninos Puppy Clock Controller

compatible: "caninos,puppy-udma-clock"

include: [clock-controller.yaml, base.yaml]

properties:
  "#clock-cells":
    const: 1

clock-cells:
  - bits
```

## dts/bindings/counter/caninos,puppy-counter.yaml
```yaml
# Copyright (c) 2026 Edgar Bernardi Righi <edgar.righi@lsitec.org.br>
# SPDX-License-Identifier: Apache-2.0

description: Puppy counter

compatible: "caninos,puppy-counter"

include: base.yaml
```

## dts/bindings/interrupt-controller/caninos,puppy-evtc.yaml
```yaml
# Copyright (c) 2026, Edgar Bernardi Righi
# SPDX-License-Identifier: Apache-2.0

description: RISC-V CPU event interrupt controller

compatible: "caninos,puppy-evtc"

include: [interrupt-controller.yaml, base.yaml]

properties:
  reg:
    required: true
  reg-names:
    required: true
  "#interrupt-cells":
    const: 1

interrupt-cells:
  - irq
```

## dts/bindings/interrupt-controller/caninos,puppy-intc.yaml
```yaml
# Copyright (c) 2026, Edgar Bernardi Righi
# SPDX-License-Identifier: Apache-2.0

description: RISC-V CPU interrupt controller

compatible: "caninos,puppy-intc"

include: [interrupt-controller.yaml, base.yaml]

properties:
  reg:
    required: true
  "#interrupt-cells":
    const: 1

interrupt-cells:
  - irq
```

## dts/bindings/misc/pulp,udma-filter.yaml
```yaml
# Copyright (c) Ana Clara Forcelli <ana.forcelli@lsitec.org.br>
# SPDX-License-Identifier: Apache-2.0

description: PULP's UDMA Filter DSP Accelerator

compatible: "pulp,udma-filter"

include: base.yaml

properties:
  reg:
    required: true
```

## dts/bindings/sdhc/caninos,puppy-sdhc.yaml
```yaml
#
# Copyright (c) 2026 Ana Clara Forcelli <ana.forcelli@lsitec.org.br>
# Copyright (c) 2026 Edgar Bernardi Righi <edgar.righi@lsitec.org.br>
#
# SPDX-License-Identifier: Apache-2.0
#

description: Puppy SDHC Controller

compatible: "caninos,puppy-sdhc"

include: [sdhc.yaml]

properties:
  clock-frequency:
    type: int
    description: clock-frequency for SDHC
  reg:
    required: true
    description: register space
  
  pwr-gpios:
    type: phandle-array
    description: |
      Power pin
      This is a configurable pin to deliver power supply to the SD card.
      It is configured as a GPIO in order to execute power toggles and
      reinitialize the SD slave when necessary.

  dat0-gpios:
    type: phandle-array
    required: true
    description: |
      DAT0 pin
      dat0 pin to check if the device is busy.
```

## dts/bindings/timer/caninos,puppy-timer.yaml
```yaml
# Copyright (c) 2026, Edgar Bernardi Righi
# SPDX-License-Identifier: Apache-2.0

description: RISC-V Puppy Machine Timer.

compatible: "caninos,puppy-timer"

include: base.yaml

properties:
  reg:
    required: true
  interrupts:
    required: true
```

## soc/caninos/puppy_v2/Kconfig.defconfig
```kconfig
if SOC_PUPPY_V2

config SYS_CLOCK_HW_CYCLES_PER_SEC
	int
	default 20000000

config SYS_CLOCK_TICKS_PER_SEC
	int
	default 31250

config RISCV_SOC_CONTEXT_SAVE
	bool
	default y

config RISCV_HAS_CPU_IDLE
	bool
	default y

config MULTI_LEVEL_INTERRUPTS
	bool
	default y

config 2ND_LEVEL_INTERRUPTS
	bool
	default y

config 1ST_LEVEL_INTERRUPT_BITS
	int
	default 5

config 2ND_LEVEL_INTERRUPT_BITS
	int
	default 9

config NUM_2ND_LEVEL_AGGREGATORS
	int
	default 1

config MAX_IRQ_PER_AGGREGATOR
	int
	default 256

config 2ND_LVL_INTR_00_OFFSET
	int
	default 26

config 2ND_LVL_ISR_TBL_OFFSET
	int
	default 32

config NUM_IRQS
	int
	default 288

config CLOCK_CONTROL
	bool
	default y

config MP_MAX_NUM_CPUS
	default 1

config HAS_FLASH_LOAD_OFFSET
	bool
	default y
	depends on BOOTLOADER_MCUBOOT

config TIMER_HAS_64BIT_CYCLE_COUNTER
	bool
	default y

endif # SOC_PUPPY
```
