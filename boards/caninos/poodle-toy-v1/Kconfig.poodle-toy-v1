## drivers/gpio/Kconfig.puppy
```kconfig
# Kconfig.puppy - puppy GPIO configuration option

config GPIO_PUPPY
	bool "Puppy GPIO controller driver"
	default y
	depends on DT_HAS_CANINOS_PUPPY_GPIO_ENABLED
	select HAS_DTS_GPIO
	help
	  Enable driver for the Puppy GPIO controller.

	  Says n if not sure.
```

## drivers/i2c/Kconfig.puppy
```kconfig
# Kconfig.puppy - puppy I2C configuration option

config I2C_PUPPY
	bool "Puppy I2C controller driver"
	default y
	depends on DT_HAS_CANINOS_PUPPY_I2C_ENABLED
	select HAS_DTS_I2C
	help
	  Enable driver for the Puppy I2C controller.

	  Says n if not sure.

config I2C_W_BLOCKING
    bool
    default y
    help
      Write funtion is of blocking type until end of transfer.
```

## drivers/misc/pulp_udma_filter/Kconfig
```kconfig
config PULP_UDMA_FILTER
    bool 
	depends on DT_HAS_PULP_UDMA_FILTER_ENABLED
    default y
    help "Enable in-chip DSP accelerator with support for up tp 32-byte data width"
```

## drivers/pwm/Kconfig.puppy
```kconfig
config PWM_PUPPY
	bool "Puppy PWM Driver"
	default y
	depends on DT_HAS_CANINOS_PUPPY_PWM_ENABLED
	help
	  Enable PWM driver for Puppy MCUs.
```

## drivers/sdhc/Kconfig.puppy
```kconfig
# Copyright (c) 2026 Caninos Loucos
# SPDX-License-Identifier: Apache-2.0

config SDHC_PUPPY
	bool "PUPPY SDHC Driver"
	default y
	depends on DT_HAS_CANINOS_PUPPY_SDHC_ENABLED
	select SDHC_SUPPORTS_NATIVE_MODE
	help
	  Enables the Puppy SD Host controller driver


# Puppy UDMA needs 32 bit aligned buffers
config SDHC_BUFFER_ALIGNMENT
	default 4
```

## drivers/spi/Kconfig.puppy
```kconfig
# Kconfig.puppy - puppy SPI configuration option

config SPI_PUPPY
	bool "Puppy SPI controller driver"
	default y
	depends on DT_HAS_CANINOS_PUPPY_SPI_ENABLED
	select HAS_DTS_SPI
	help
	  Enable driver for the Puppy SPI controller.

	  Says n if not sure.
```

## dts/bindings/gpio/caninos,puppy-gpio.yaml
```yaml
description: >
    This is a representation of the Puppy GPIO node

include: [gpio-controller.yaml, base.yaml]

compatible: "caninos,puppy-gpio"

properties:

    reg:
      required: true
      description: mmio register space

    "#gpio-cells":
      const: 2

gpio-cells:
  - pin
  - flags
```

## dts/bindings/i2c/caninos,puppy-i2c.yaml
```yaml
description: >
  This is a representation of the Puppy I2C node

include: [i2c-controller.yaml, base.yaml]

compatible: "caninos,puppy-i2c"

properties:
  reg:
    required: true
    description: mmio register space

  i2c-id:
    required: true
    type: int
    description: ID of the I2C hardware instance

  sda-pin:
    type: int
    description: SDA pin select number used only for I2C1

  scl-pin:
    type: int
    description: SCL pin select number used only for I2C1
```

## dts/bindings/interrupt-controller/caninos,puppy-event-unit.yaml
```yaml
description: >
    This binding describes the Puppy Event Unit

include: [interrupt-controller.yaml, base.yaml]

compatible: "caninos,puppy-event-unit"

properties:
  reg:
      required: true
      description: mmio register space

  "#interrupt-cells":
      const: 1

interrupt-cells:
  - irq
```

## dts/bindings/pwm/caninos,puppy-pwm.yaml
```yaml
# Copyright (c) 2026 Caninos Loucos
# SPDX-License-Identifier: Apache-2.0

description: Caninos PWM Module

compatible: "caninos,puppy-pwm"

include: [pwm-controller.yaml, base.yaml]

properties:
  reg:
    required: true
  pwm-id:
    type: int
    required: true
  "#pwm-cells":
    const: 3

pwm-cells:
  - channel
  # period in terms of nanoseconds
  - period
  - flags
```

## dts/bindings/serial/caninos,puppy-uart.yaml
```yaml
description: >
  This is a representation of the Puppy UART node

include: [uart-controller.yaml, base.yaml]

compatible: "caninos,puppy-uart"

properties:
  reg:
    required: true
    description: mmio register space

  uart-id:
    required: true
    type: int
    description: ID of the hardware UART instance
```

## dts/bindings/spi/caninos,puppy-spi.yaml
```yaml
description: >
  This is a representation of the Puppy SPI node

include: [spi-controller.yaml, base.yaml]

compatible: "caninos,puppy-spi"

properties:
  reg:
    required: true
    description: mmio register space

  spi-id:
    required: true
    type: int
    description: ID of the SPI instance
```

## soc/caninos/Kconfig.soc
```kconfig
config SOC_SERIES_PUPPY
	bool

config SOC_SERIES
	default "puppy" if SOC_SERIES_PUPPY

rsource "*/Kconfig.soc"
```

## soc/caninos/puppy_v1/Kconfig
```kconfig
config SOC_PUPPY_V1
	bool
	select RISCV
	select RISCV_PUPPY
	select RISCV_ISA_RV32I
	select RISCV_ISA_EXT_M
	select RISCV_ISA_EXT_F
	select RISCV_ISA_EXT_C
	select RISCV_ISA_EXT_ZICSR
	select ATOMIC_OPERATIONS_C
```

## soc/caninos/puppy_v1/Kconfig.soc
```kconfig
config SOC_PUPPY_V1
	bool
	select SOC_SERIES_PUPPY

config SOC
	default "puppy_v1" if SOC_PUPPY_V1
```

## soc/caninos/puppy_v2/Kconfig.soc
```kconfig
config SOC_PUPPY_V2
	bool
	select SOC_SERIES_PUPPY

config SOC
	default "puppy_v2" if SOC_PUPPY_V2
```
